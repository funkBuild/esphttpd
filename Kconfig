## Kconfig
```kconfig
menu "ESPHTTPD Configuration"

    menu "Router Configuration"

        config HTTPD_MAX_ROUTERS
            int "Maximum number of routers"
            default 8
            range 1 32
            help
                Maximum router instances that can be created.
                Each router uses approximately 200 bytes base memory plus
                memory for routes and middleware.

        config HTTPD_MAX_ROUTER_NESTING
            int "Maximum router nesting depth"
            default 4
            range 1 8
            help
                Maximum depth of nested routers.
                For example, /api/v1/users/profile = 4 levels.
                Affects stack usage during routing.

        config HTTPD_MAX_RADIX_NODES
            int "Maximum radix tree nodes per router"
            default 64
            range 16 256
            help
                Maximum nodes in the route tree per router.
                Typical usage: 2-3 nodes per route.

        config HTTPD_MAX_ROUTE_PARAMS
            int "Maximum route parameters"
            default 8
            range 2 16
            help
                Maximum number of :param captures per route.
                Example: /users/:userId/posts/:postId requires 2.

        config HTTPD_MAX_MIDDLEWARE_PER_ROUTER
            int "Maximum middleware per router"
            default 8
            range 1 16
            help
                Maximum middleware functions that can be registered
                per router using httpd_router_use().

        config HTTPD_MAX_ROUTE_MIDDLEWARE
            int "Maximum middleware per route"
            default 4
            range 1 8
            help
                Maximum middleware functions that can be attached
                to a single route.

        config HTTPD_MAX_TOTAL_MIDDLEWARE
            int "Maximum middleware chain length"
            default 16
            range 4 32
            help
                Total maximum middleware across all routers + route
                for a single request. This is the sum of:
                - Server global middleware
                - All router middleware in the chain
                - Route-specific middleware

    endmenu

    menu "Connection Configuration"

        config HTTPD_MAX_CONNECTIONS
            int "Maximum concurrent connections"
            default 16
            range 1 32
            help
                Maximum number of simultaneous HTTP connections.
                Per-connection contexts are allocated dynamically.
                This only affects the connection pool size (~40 bytes each).

        config HTTPD_DEFAULT_PORT
            int "Default server port"
            default 80
            range 1 65535
            help
                Default port for HTTP server to listen on.

        config HTTPD_RECV_BUFFER_SIZE
            int "Receive buffer size"
            default 1024
            range 512 4096
            help
                Size of receive buffer for incoming data.

        config HTTPD_SEND_BUFFER_SIZE
            int "Send buffer size"
            default 1024
            range 512 4096
            help
                Size of send buffer for outgoing data.

        config HTTPD_MAX_REQ_HEADERS
            int "Maximum request headers"
            default 16
            range 8 32
            help
                Maximum number of HTTP headers to index per request.
                Each header entry uses 6 bytes.

        config HTTPD_MAX_QUERY_PARAMS
            int "Maximum query parameters"
            default 8
            range 4 16
            help
                Maximum number of query string parameters to cache.
                Each parameter entry uses ~12 bytes.

        config HTTPD_MAX_SERVER_MIDDLEWARES
            int "Maximum server-level middlewares"
            default 4
            range 1 16
            help
                Maximum middleware functions at server level.
                Each middleware is a function pointer (4 bytes).

    endmenu

    menu "WebSocket Configuration"

        config HTTPD_MAX_WS_ROUTES
            int "Maximum WebSocket routes"
            default 8
            range 1 32
            help
                Maximum number of WebSocket route patterns.
                Each route uses ~80 bytes (64-byte pattern + handlers).

        config HTTPD_MAX_WS_CHANNELS
            int "Maximum WebSocket pub/sub channels"
            default 16
            range 8 32
            help
                Maximum number of pub/sub channels.
                Channel hash table is lazy-allocated on first use.

        config HTTPD_WS_SEND_QUEUE_SIZE
            int "WebSocket send queue size"
            default 2048
            range 512 8192
            help
                Size of ring buffer for queuing WebSocket messages.

    endmenu

endmenu
```

## test_app/sdkconfig.defaults
```kconfig
# Default configuration for QEMU ESP32S3 testing

# ESP32S3 specific
CONFIG_IDF_TARGET="esp32s3"
CONFIG_IDF_TARGET_ESP32S3=y

# Unity test framework
CONFIG_UNITY_ENABLE_FIXTURE=y
CONFIG_UNITY_ENABLE_IDF_TEST_RUNNER=n

# Optimization for testing
CONFIG_COMPILER_OPTIMIZATION_SIZE=y
CONFIG_COMPILER_OPTIMIZATION_ASSERTIONS_ENABLE=y

# Log output
CONFIG_LOG_DEFAULT_LEVEL_INFO=y
CONFIG_LOG_COLORS=y
CONFIG_LOG_TIMESTAMP_SOURCE_RTOS=y

# FreeRTOS
CONFIG_FREERTOS_HZ=1000
CONFIG_FREERTOS_ASSERT_ON_UNTESTED_FUNCTION=y

# Main task stack size
CONFIG_ESP_MAIN_TASK_STACK_SIZE=8192

# QEMU specific settings
CONFIG_ESP_SYSTEM_PANIC_PRINT_HALT=y
CONFIG_ESP_SYSTEM_PANIC_SILENT_REBOOT=n

# Disable unnecessary components for faster build
CONFIG_ESP_WIFI_ENABLED=n
CONFIG_BT_ENABLED=n
CONFIG_SPI_FLASH_DANGEROUS_WRITE_ALLOWED=n

# lwIP settings (for socket tests if needed)
CONFIG_LWIP_MAX_SOCKETS=32
CONFIG_LWIP_SO_REUSE=y
CONFIG_LWIP_SO_RCVBUF=y
CONFIG_LWIP_TCP_NODELAY=y

# Memory settings
CONFIG_ESP32S3_SPIRAM_SUPPORT=n
```

## test_e2e/sdkconfig.defaults
```kconfig
# ESP32S3 QEMU Configuration with OpenCores Ethernet MAC
CONFIG_IDF_TARGET="esp32s3"

# Enable OpenCores Ethernet MAC (for QEMU)
CONFIG_ETH_USE_OPENETH=y
CONFIG_ETH_OPENETH_DMA_RX_BUFFER_NUM=4
CONFIG_ETH_OPENETH_DMA_TX_BUFFER_NUM=1

# LWIP Configuration
CONFIG_LWIP_LOCAL_HOSTNAME="esp32s3-e2e"
CONFIG_LWIP_IPV4=y

# FreeRTOS Configuration
CONFIG_FREERTOS_HZ=1000
CONFIG_FREERTOS_UNICORE=n

# Main task stack size
CONFIG_ESP_MAIN_TASK_STACK_SIZE=4096

# HTTP Server settings
CONFIG_HTTPD_MAX_REQ_HDR_LEN=1024
CONFIG_HTTPD_MAX_URI_LEN=512

# Disable unnecessary features for faster QEMU
CONFIG_ESP_SYSTEM_PANIC_PRINT_HALT=y
CONFIG_BOOTLOADER_LOG_LEVEL_WARN=y
CONFIG_LOG_DEFAULT_LEVEL_INFO=y
```
